/ {
    keymap {
        compatible = "zmk,keymap";

        default_layer {
            bindings = <
                &kp C_MUTE
            >;
        };
    };
};

&encoder0 {
    bindings = < &kp C_VOL_UP &kp C_VOL_DN >;
};
